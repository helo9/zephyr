## tests/drivers/sensor/i3g4250d/testcase.yaml
```yaml
tests:
  driver.sensor.i3g4250d:
    extra_args: CONF_FILE=prj.conf
    tags: driver sensor subsys i3g4250d
    platform_allow: stm32f3_disco@E
```
